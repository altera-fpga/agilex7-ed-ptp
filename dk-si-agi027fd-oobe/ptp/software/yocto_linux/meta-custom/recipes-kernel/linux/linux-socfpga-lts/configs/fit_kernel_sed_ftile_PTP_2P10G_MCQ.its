## dk-si-agi027fd-oobe/ptp/software/yocto_linux/meta-custom/recipes-kernel/linux/linux-socfpga-lts/configs/fit_kernel_sed_ftile_PTP_2P10G_MCQ.its
```
// SPDX-License-Identifier: GPL-2.0
/*
 * Copyright (C) 2019 Intel Corporation
 *
 */

/dts-v1/;

/ {
	description = "FIT image with kernel, DTB and FPGA core binary";
	#address-cells = <1>;

	images {
		kernel {
			description = "Linux Kernel";
			data = /incbin/("./Image_sed.lzma");
			type = "kernel";
			arch = "arm64";
			os = "linux";
			compression = "lzma";
			load = <0x6000000>;
			entry = <0x6000000>;
			hash {
				algo = "sha256";
			};
		};

		fdt-0 {
			description = "socfpga_fm87_ftile_ptp";
			data = /incbin/("./socfpga_fm87_ftile_10g_2port_2conn_mcq_ptp.dtb");
			type = "flat_dt";
			arch = "arm64";
			compression = "none";
			hash {
				algo = "sha256";
			};
		};


		fpga-0 {
			description = "FPGA bitstream for GHRD";
			data = /incbin/("./ghrd.core.rbf");
			type = "fpga";
			arch = "arm64";
			compression = "none";
			load = <0xA000000>;
			hash {
				algo = "sha256";
			};
		};
	};

	configurations {
		default = "board-4";

		board-4 {
			description = "board_4";
			kernel = "kernel";
			fdt = "fdt-0";
			fpga = "fpga-0";
			signature {
				algo = "sha256,rsa2048";
				key-name-hint = "dev";
				sign-images = "fdt-0", "kernel", "fpga-0";
			};
		};
		board-0 {
			description = "board_0";
			kernel = "kernel";
			fdt = "fdt-0";
			fpga = "fpga-0";
			signature {
				algo = "sha256,rsa2048";
				key-name-hint = "dev";
				sign-images = "fdt-0", "kernel", "fpga-0";
			};
		};
	};
};
```
